#include <U8glib.h>
#include <Wire.h>
#include <SPI.h>
#include <stdlib.h>
#include <Adafruit_GFX.h>
#include <Adafruit_SSD1306.h> 

#define CURRENT A0
#define TENSION A1
#define N 10 //numero de pontos para media de tensão

#define SCREEN_WIDTH 128 // Largura display, em pixels
#define SCREEN_HEIGHT 64 // Altura display, em pixels
  
// Declaração pino reset para I2C
#define OLED_RESET  -1 // Será o mesmo reset da placa

// Criação objeto display
Adafruit_SSD1306 display(SCREEN_WIDTH, SCREEN_HEIGHT, &Wire, OLED_RESET);
  
// Altura e largura logo (alterar tamanho se necessário)
#define LOGO_WIDTH  128
#define LOGO_HEIGHT   64

// 'Logo Milhagem UFMG Branca', 128x64px
static const unsigned char PROGMEM LogoMilhagem [] = {
  0x00, 0x00, 0x00, 0x00, 0x00, 0x03, 0x00, 0x00, 0x00, 0x00, 0x00, 0x00, 0x00, 0x00, 0x00, 0x00, 
  0x00, 0x00, 0x00, 0x00, 0x00, 0x03, 0x00, 0x00, 0x00, 0x00, 0x00, 0x00, 0x00, 0x00, 0x00, 0x00, 
  0x00, 0x00, 0x00, 0x00, 0x00, 0x07, 0x00, 0x00, 0x00, 0x00, 0x00, 0x00, 0x00, 0x00, 0x00, 0x00, 
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  0x00, 0x00, 0x00, 0x00, 0x00, 0x00, 0x00, 0x00, 0x00, 0x00, 0x00, 0xe6, 0x32, 0x47, 0x80, 0x00
};

U8GLIB_SSD1306_128X64 u8g(U8G_I2C_OPT_NO_ACK);

const double ajuste_corrente = 1.2297601967717135494;

float originalTensao = 0.0; 
float originalCorrente = 0.0; 
float filtradoTensao = 0.0;
float filtradoCorrente = 0.0;
float gasto = 0.0;
float numbersTensao[N];
float numbersCorrente[N];


float mediaMovelTensao();
float mediaMovelCorrente();

void setup() {

  //Incia a Serial
  Serial.begin(115200); 
  pinMode(CURRENT, INPUT);
  pinMode(TENSION, INPUT);

  // SSD1306_SWITCHCAPVCC = gerar tensão para display 3.3V internamente
  if(!display.begin(SSD1306_SWITCHCAPVCC, 0x3C)) { // 0x3C sendo o end I2C
    Serial.println(F("Falha alocação SSD1306"));
    for(;;); // Não processado, loop infinito
  }
  // Limpa display
  display.clearDisplay();

  // Chama sub-rotina
  testdrawbitmap();
  // Inverte cores no display
  display.invertDisplay(true);
  // Aguarda 1 s
  delay(1000);
  // Volta às cores originais no display
  display.invertDisplay(false);

  //Zera vetor da media movel


}

void testdrawbitmap(void) {
  // Limpa display
  display.clearDisplay();
  
  // Preenche tela com bitmap
  display.drawBitmap(
    (display.width()  - LOGO_WIDTH ) / 2,
    (display.height() - LOGO_HEIGHT) / 2,
    LogoMilhagem, LOGO_WIDTH, LOGO_HEIGHT, 1);
  // Exibe no display 
  display.display();

#ifdef AVR_ATmega32U4
  delay(2000);
#endif

  u8g.begin();
}

void loop() {

  /* ------ TENSÃO ------ */

  originalTensao = analogRead(TENSION) * (5/1023.0);
  originalTensao = originalTensao * 9.54; // Vin/Vout=9.54
  filtradoTensao = mediaMovelTensao();

  /* ----- CORRENTE ----- */

  originalCorrente = analogRead(CURRENT);
  originalCorrente = map(originalCorrente, 0, 1023, (-30000), 30000);
  originalCorrente /= 1000; //mA => A
  filtradoCorrente = mediaMovelCorrente();

  /* ------ GASTO ------ */
  
  gasto += filtradoCorrente*ajuste_corrente*filtradoTensao;

  /* ----- DISPLAY ----- */

  Serial.print(filtradoTensao);
  Serial.println(" V");
  Serial.print(filtradoCorrente*ajuste_corrente, 5);
  Serial.println(" mA");
  Serial.print(gasto, 5);
  Serial.println(" J");

  

  u8g.firstPage();
  do {
    u8g.setFont(u8g_font_courR10);
    u8g.setPrintPos(0, 15);
    u8g.print(filtradoTensao);
    u8g.print(" V");

    u8g.setPrintPos(0, 37);
    u8g.print(filtradoCorrente*ajuste_corrente);
    u8g.print(" mA");
    
    u8g.setPrintPos(0, 60);
    u8g.print(gasto);
    u8g.print(" J");

  } while ( u8g.nextPage());

  delay(1000);

}

float mediaMovelTensao(){
  for (int i = N-1; i > 0; i--){
    numbersTensao[i] = numbersTensao[i-1];
  }

  numbersTensao[0]=originalTensao;
  float acc=0;

  for(int i=0; i<N; i++){
    acc+= numbersTensao[i];
  }

  return acc/N;
}


float mediaMovelCorrente(){
  for (int i = N-1; i > 0; i--){
    numbersCorrente[i] = numbersCorrente[i-1];
  }

  numbersCorrente[0]=originalCorrente;
  float acc=0;
  
  for(int i=0; i<N; i++){
    acc+= numbersCorrente[i];
  }

  return acc/N;
}

